## prj.conf
```kconfig
# https://docs.nordicsemi.com/bundle/ncs-latest/page/nrf/security/ap_protect.html#disabling_software_ap-protect_with_confignrfapprotectdisable
CONFIG_NRF_APPROTECT_USE_UICR=y

#CONFIG_NRF_APPROTECT_LOCK=n ; causes flash erasure if you use this.
#CONFIG_NRF_APPROTECT_USER_HANDLING=n
#CONFIG_NRF_APPROTECT_USE_UICR=n
#CONFIG_NRF_APPROTECT_USER_HANDLING=y

#CONFIG_NRF_SECURE_APPROTECT_USE_UICR=n
#CONFIG_NRF_SECURE_APPROTECT_USER_HANDLING=y # based on line 66 in system_nrf53_approtect.h
```

## src/main.c
```c
/*
 * Copyright (c) 2012-2014 Wind River Systems, Inc.
 *
 * SPDX-License-Identifier: Apache-2.0
 */

#include <zephyr/kernel.h>
#include <zephyr/sys/printk.h>

// static void config_nvmc(uint32_t val)
// {
//     while (!NRF_NVMC_S->READY);
//     NRF_NVMC_S->CONFIG = val;
//     while (!NRF_NVMC_S->READY);
// }

void main(void)
{
    uint32_t read_val;

    printk("Start approtect sample.\n");
    //NRF_CTRLAP_S->APPROTECT.DISABLE = 0x00000055; // our key


    printk("Entering forever loop.\n");
    printk("Disclaimer: This example does not lock netcore, and can be unlocked by recovering netcore!\n See README for more information.\n");
    while(1){
        k_sleep(K_SECONDS(1));
    }
}
```
